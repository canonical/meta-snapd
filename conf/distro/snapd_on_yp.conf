## conf/distro/snapd_on_yp.conf
```bitbake
#####################################################
#
#  To take advantage of this conf file, add the line
#
#  DISTRO = "snapd_on_yp"
#
#  to your local.conf file.
#
#####################################################

# Select systemd as the init manager (required).
INIT_MANAGER = "systemd"

# Build the final image from .deb packages.
PACKAGE_CLASSES = "package_deb"

# If you want on-board package management, uncomment this line.
# IMAGE_FEATURES:append = " package-management"

# Add the essential DISTRO_FEATURES.
DISTRO_FEATURES:append = " \
	apparmor \
	security \
"

# snapd really wants root's home dir at /root, not /home/root.
ROOT_HOME = "/root"
```
